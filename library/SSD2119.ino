/*
  SSD2119 Library
  REV 5
  
    REV Log:
    1 - Basic functionality
    2 - Arduino 1.6.7 / 1.6.8 compatibility (function prototypes on one line)
    3 - Added Big Font with background and foreground colors
    4 - Added support for Arduino Due and its extended SPI functions https://www.arduino.cc/en/Reference/DueExtendedSPI
    5 - Removed GENUINO references
  
  Developed by TheFax using:
  -SSD2119 datasheet, by SOLOMON SYSTECH (Rev 1.4 - June 2009)
  -code wrote by TheFax
  -code scraps by CooCox (Copyright (c)2011, CooCox)
  -code scraps wrote by Steven Prickett (Kentec 320x240x16 BoosterPack)

  ---->  NOT FOR COMMERCIAL USE  <----

  Date:              November 2015
  Hardware target:   Arduino Mega -> 4-wire SPI bus -> SSD2119
  Developer:         TheFax
  This class contains:
  SSD2119_init()                                      --> Setup of Color LCD display based on SSD2119
  SSD2119DrawOnePixel(X,Y,Color)                      --> Draw only one pixel
  SSD2119DrawVerticalLine(X,Y,EndX,EndY,Color)        --> Draw a vertical line
  SSD2119PutChar8x16(X,Y,CHAR,foreColor,backColor)    --> Draw a char in the LCD
  SSD2119DisplayString(X,Y,char*,foreColor,backColor) --> Draw a string in the LCD
  SPI_init()                                          --> Intended for internal-class use only (Setup of SPI interface on Arduino board)
  SSD2119SetCurPos(StartX,EndX,StartY,EndY)           --> Intended for internal-class use only
  SSD2119Write(...)                                   --> Intended for internal-class use only (Contains low level not-optimized routines)
  SSD2119WriteCmd(...)                                --> Intended for internal-class use only
  SSD2119WriteData(...)                               --> Intended for internal-class use only
  SSD2119WritePixelData(...)                          --> Intended for internal-class use only

  This class uses the 4 wire SPI bus of the LCD display.
  Connections:
  DISPLAY    |    ARDUINO Mega 2560           |  Notes
  Reset      |    47                          | (LCD reset, low active)
  SCL        |    52    (MANDATORY)           | (SPI Clock)
  DC         |    49                          | (Data/Command)
  CS         |    48                          | (Circuit Select, low active)
  SDI        |    51    (MANDATORY)           | (SPI transfer, from uP to LCD)
  SS         |    53  (Don't use - keep free) | (Arduino Slave Select - DO NOT USE FOR GENERAL PURPUOSE)

  DISPLAY    |    ARDUINO DUE                 |  Notes
  Reset      |    47                          | (LCD reset, low active)
  SCL        |    on SPI connector            | (SPI Clock)
  DC         |    49                          | (Data/Command)
  CS         |    10                          | (Circuit Select, low active)
  SDI        |    on SPI connector            | (SPI transfer, from uP to LCD)
*/

//Include the SPI library:
#include <SPI.h>

//Input/Output pins
#define SSD2119_DC                              49
#define SSD2119_RST                             47

#define HARDWARE_IS_ARDUINO_DUE                 true
//CS diventa il pin 10

#define HARDWARE_IS_ARDUINO_MEGA                false
#define SSD2119_CS                              48
#define SS_ATMEL_RESERVED                       53

//Operative logic states
#define SSD2119_DC_COMMAND                      LOW
#define SSD2119_DC_DATA                         HIGH
#define SSD2119_NORMAL_REG                      HIGH
#define SSD2119_GRAM_REG                        LOW

//SSD2119 datasheet
#define SSD2119_DEVICE_CODE_READ_REG            0x00
#define SSD2119_OSC_START_REG                   0x00
#define SSD2119_OUTPUT_CTRL_REG                 0x01
#define SSD2119_LCD_DRIVE_AC_CTRL_REG           0x02
#define SSD2119_PWR_CTRL_1_REG                  0x03
#define SSD2119_DISPLAY_CTRL_REG                0x07
#define SSD2119_FRAME_CYCLE_CTRL_REG            0x0B
#define SSD2119_PWR_CTRL_2_REG                  0x0C
#define SSD2119_PWR_CTRL_3_REG                  0x0D
#define SSD2119_PWR_CTRL_4_REG                  0x0E
#define SSD2119_GATE_SCAN_START_REG             0x0F
#define SSD2119_SLEEP_MODE_1_REG                0x10
#define SSD2119_ENTRY_MODE_REG                  0x11
#define SSD2119_GEN_IF_CTRL_REG                 0x15
#define SSD2119_PWR_CTRL_5_REG                  0x1E
#define SSD2119_RAM_DATA_REG                    0x22
#define SSD2119_FRAME_FREQ_REG                  0x25
#define SSD2119_VCOM_OTP_1_REG                  0x28
#define SSD2119_VCOM_OTP_2_REG                  0x29
#define SSD2119_GAMMA_CTRL_1_REG                0x30
#define SSD2119_GAMMA_CTRL_2_REG                0x31
#define SSD2119_GAMMA_CTRL_3_REG                0x32
#define SSD2119_GAMMA_CTRL_4_REG                0x33
#define SSD2119_GAMMA_CTRL_5_REG                0x34
#define SSD2119_GAMMA_CTRL_6_REG                0x35
#define SSD2119_GAMMA_CTRL_7_REG                0x36
#define SSD2119_GAMMA_CTRL_8_REG                0x37
#define SSD2119_GAMMA_CTRL_9_REG                0x3A
#define SSD2119_GAMMA_CTRL_10_REG               0x3B
#define SSD2119_V_SCROLL_CTRL_1_REG             0x41
#define SSD2119_V_SCROLL_CTRL_2_REG             0x42
#define SSD2119_V_RAM_POS_REG                   0x44
#define SSD2119_H_RAM_START_REG                 0x45
#define SSD2119_H_RAM_END_REG                   0x46
#define SSD2119_SCREEN_1_START_POS_REG          0x48
#define SSD2119_SCREEN_1_END_POS_REG            0x49
#define SSD2119_SCREEN_2_START_POS_REG          0x4A
#define SSD2119_SCREEN_2_END_POS_REG            0x4B
#define SSD2119_X_RAM_ADDR_REG                  0x4E
#define SSD2119_Y_RAM_ADDR_REG                  0x4F
#define SSD2119_OUTPUTCTL_REV                   0x30EF
#define SSD2119_OUTPUTCTL_SET(ulConfig)         (ulConfig | 0x30EF)
#define SSD2119_OUTPUT_ORIGIN_UPLEFT            0x4200
#define SSD2119_OUTPUT_ORIGIN_DOWNLEFT          0x4000
#define SSD2119_OUTPUT_ORIGIN_UPRIGHT           0x0200
#define SSD2119_OUTPUT_ORIGIN_DOWNRIGHT         0x0000
#define SSD2119_LCD_WAVEFORM_REV                0x30EF
#define SSD2119_3DIV_SCR_MODE                   0x1000
#define SSD2119_WSYNC_MODE1                     0x0800
#define SSD2119_WSYNC_MODE2                     0x0900
#define SSD2119_PC1_8COLOR_DTC_SET(ucConfig)    ((0x0f & ucConfig) << 12)
#define SSD2119_PC1_8COLOR_BT_SET(ucConfig)     ((0x07 & ucConfig) << 9)
#define SSD2119_PC1_26KCOLOR_DC_SET(ucConfig)   ((0x0F & ucConfig) << 4)
#define SSD2119_PC1_26KCOLOR_AP_SET(ucConfig)   ((0x0E & ucConfig) << 0)
#define SSD2119_DISPLAY_MODE_DEFAULT            0x0033
#define SSD2119_DISPLAY_MODE_SET(x)             ((x) | 0x0033)
#define SSD2119_SCREEN_TWODIV_ENABLE            0x0100
#define SSD2119_SCREEN_TWODIV_DATA18            0x0200
#define SSD2119_SCREEN_TWODIV_DATA9             0x0600
#define SSD2119_DISPLAY_8COLOR                  0x0008
#define SSD2119_FCC_NO_SET(ucConfig)            ((ucConfig & 0x3) << 14)
#define SSD2119_FCC_SDT_SET(ucConfig)           ((ucConfig & 0x3) << 12)
#define SSD2119_FCC_EQ_SET(ucConfig)            ((ucConfig & 0x7) << 8)
#define SSD2119_FCC_DIV_SET(ucConfig)           ((ucConfig & 0x3) << 6)
#define SSD2119_FCC_DIV_ENABLE                  0x0020
#define SSD2119_FCC_RTN_ENABLE                  0x0010
#define SSD2119_FCC_RTN_SET(ucConfig)           ((ucConfig & 0xF) << 0)
#define SSD2119_OUTPUT_VOLTAGE_SET(ulConfig)    (ulConfig & 0x7)
#define SSD2119_OUTPUT_VOLTAGE_5_1V             0x0000
#define SSD2119_OUTPUT_VOLTAGE_5_3V             0x0001
#define SSD2119_OUTPUT_VOLTAGE_5_5V             0x0002
#define SSD2119_OUTPUT_VOLTAGE_5_7V             0x0003
#define SSD2119_OUTPUT_VOLTAGE_5_9V             0x0004
#define SSD2119_OUTPUT_VOLTAGE_6_1V             0x0005
#define SSD2119_VLCD63_SET(ulConfig)            (ulConfig)
#define SSD2119_VREF_TIMES_1_78                 0x0003
#define SSD2119_VREF_TIMES_1_85                 0x0004
#define SSD2119_VREF_TIMES_1_93                 0x0005
#define SSD2119_VREF_TIMES_2_02                 0x0006
#define SSD2119_VREF_TIMES_2_09                 0x0007
#define SSD2119_VREF_TIMES_2_165                0x0008
#define SSD2119_VREF_TIMES_2_245                0x0009
#define SSD2119_VREF_TIMES_2_335                0x000A
#define SSD2119_VREF_TIMES_2_40                 0x000B
#define SSD2119_VREF_TIMES_2_45                 0x000C
#define SSD2119_VREF_TIMES_2_57                 0x000D
#define SSD2119_VREF_TIMES_2_645                0x000E
#define SSD2119_VREF_TIMES_2_725                0x000F
#define SSD2119_VREF_TIMES_2_81                 0x0000
#define SSD2119_VREF_TIMES_2_90                 0x0001
#define SSD2119_VREF_TIMES_3_00                 0x0002
#define SSD2119_VREF_VOLTAGE                    2.0
#define SSD2119_VCOM_SET(ulConfig)              (ulConfig)
#define SSD2119_VLCD63_TIMES_0_60               0x2000
#define SSD2119_VLCD63_TIMES_0_63               0x2100
#define SSD2119_VLCD63_TIMES_0_66               0x2200
#define SSD2119_VLCD63_TIMES_0_69               0x2300
#define SSD2119_VLCD63_TIMES_0_72               0x2400
#define SSD2119_VLCD63_TIMES_0_75               0x2500
#define SSD2119_VLCD63_TIMES_0_78               0x2600
#define SSD2119_VLCD63_TIMES_0_81               0x2700
#define SSD2119_VLCD63_TIMES_0_84               0x2800
#define SSD2119_VLCD63_TIMES_0_87               0x2900
#define SSD2119_VLCD63_TIMES_0_90               0x2A00
#define SSD2119_VLCD63_TIMES_0_93               0x2B00
#define SSD2119_VLCD63_TIMES_0_96               0x2C00
#define SSD2119_VLCD63_TIMES_0_99               0x2D00
#define SSD2119_VLCD63_TIMES_1_02               0x2E00
#define SSD2119_VLCD63_TIMES_1_05               0x3000
#define SSD2119_VLCD63_TIMES_1_08               0x3100
#define SSD2119_VLCD63_TIMES_1_11               0x3200
#define SSD2119_VLCD63_TIMES_1_14               0x3300
#define SSD2119_VLCD63_TIMES_1_17               0x3400
#define SSD2119_VLCD63_TIMES_1_20               0x3500
#define SSD2119_VLCD63_TIMES_1_23               0x3600
#define SSD2119_VLCD63_TIMES_EXT                0x2F00
#define SSD2119_SCN_STAART_GATE_SET(ulConfig)   (ulConfig & 0x1FF)
#define SSD2119_SLEEP_MODE_ENTER                0x0001
#define SSD2119_SLEEP_MODE_EXIT                 0x0000
#define SSD2119_ENTRY_MODE_DEFAULT              0x48B0  //0x6830
#define SSD2119_ENTRY_MODE_SET(x)               ((SSD2119_ENTRY_MODE_DEFAULT & 0xFF00) | (x))
#define SSD2119_EM_VSYNC_INPUT                  0x8000
#define SSD2119_EM_65KCOLOR                     0x6000
#define SSD2119_EM_262KCOLOR                    0x4000
#define SSD2119_EM_HVSYNC_OFF                   0x0800
#define SSD2119_EM_RAM_RGB                      0x0400
#define SSD2119_EM_RAM_SPI                      0x0000
#define SSD2119_EM_DM_CHANGE_IMMEDIATELY        0x0200
#define SSD2119_EM_DM_CHANNGE_START             0x0000
#define SSD2119_EM_CLOCK_OSC                    0x0100
#define SSD2119_EM_CLOCK_DOTCLK                 0x0000
#define SSD2119_EM_262K_TY_A                    0x0000
#define SSD2119_EM_262K_TY_B                    0x0040
#define SSD2119_EM_262K_TY_C                    0x0080
#define SSD2119_EM_ADDR_INC                     0x0010
#define SSD2119_EM_ADDR_DEC                     0x0000
#define SSD2119_EM_DIRECTION_H                  0x0000
#define SSD2119_EM_DIRECTION_V                  0x0008
#define SSD2119_GIC_LATCH_POS                   0x0000
#define SSD2119_GIC_LATCH_NEG                   0x0008
#define SSD2119_GIC_DEN_H                       0x0000
#define SSD2119_GIC_DEN_L                       0x0004
#define SSD2119_GIC_VHS_H                       0x0002
#define SSD2119_GIC_VHS_L                       0x0000
#define SSD2119_GIC_VVS_H                       0x0001
#define SSD2119_GIC_VVS_L                       0x0000
#define SSD2119_VCOMH_SET(ulConfig)             (ulConfig | 0xFF)
#define SSD2119_VCOMH_OTP                       0x0000
#define SSD2119_VLCD_TIMES_0_36                 0x0080
#define SSD2119_VLCD_TIMES_0_37                 0x0081
#define SSD2119_VLCD_TIMES_0_38                 0x0082
#define SSD2119_VLCD_TIMES_0_39                 0x0083
#define SSD2119_VLCD_TIMES_0_40                 0x0084
#define SSD2119_VLCD_TIMES_0_41                 0x0085
#define SSD2119_VLCD_TIMES_0_42                 0x0086
#define SSD2119_VLCD_TIMES_0_43                 0x0087
#define SSD2119_VLCD_TIMES_0_44                 0x0088
#define SSD2119_VLCD_TIMES_0_45                 0x0089
#define SSD2119_VLCD_TIMES_0_46                 0x008A
#define SSD2119_VLCD_TIMES_0_47                 0x008B
#define SSD2119_VLCD_TIMES_0_48                 0x008C
#define SSD2119_VLCD_TIMES_0_49                 0x008D
#define SSD2119_VLCD_TIMES_0_50                 0x008E
#define SSD2119_VLCD_TIMES_0_51                 0x008F
#define SSD2119_VLCD_TIMES_0_52                 0x0090
#define SSD2119_VLCD_TIMES_0_53                 0x0091
#define SSD2119_VLCD_TIMES_0_54                 0x0092
#define SSD2119_VLCD_TIMES_0_55                 0x0093
#define SSD2119_VLCD_TIMES_0_56                 0x0094
#define SSD2119_VLCD_TIMES_0_57                 0x0095
#define SSD2119_VLCD_TIMES_0_58                 0x0096
#define SSD2119_VLCD_TIMES_0_59                 0x0097
#define SSD2119_VLCD_TIMES_0_60                 0x0098
#define SSD2119_VLCD_TIMES_0_61                 0x0099
#define SSD2119_VLCD_TIMES_0_62                 0x009A
#define SSD2119_VLCD_TIMES_0_63                 0x009B
#define SSD2119_VLCD_TIMES_0_64                 0x009C
#define SSD2119_VLCD_TIMES_0_65                 0x009D
#define SSD2119_VLCD_TIMES_0_66                 0x009E
#define SSD2119_VLCD_TIMES_0_67                 0x009F
#define SSD2119_VLCD_TIMES_0_68                 0x00A0
#define SSD2119_VLCD_TIMES_0_69                 0x00A1
#define SSD2119_VLCD_TIMES_0_70                 0x00A2
#define SSD2119_VLCD_TIMES_0_71                 0x00A3
#define SSD2119_VLCD_TIMES_0_72                 0x00A4
#define SSD2119_VLCD_TIMES_0_73                 0x00A5
#define SSD2119_VLCD_TIMES_0_74                 0x00A6
#define SSD2119_VLCD_TIMES_0_75                 0x00A7
#define SSD2119_VLCD_TIMES_0_76                 0x00A8
#define SSD2119_VLCD_TIMES_0_77                 0x00A9
#define SSD2119_VLCD_TIMES_0_78                 0x00AA
#define SSD2119_VLCD_TIMES_0_79                 0x00AB
#define SSD2119_VLCD_TIMES_0_80                 0x00AC
#define SSD2119_VLCD_TIMES_0_81                 0x00AD
#define SSD2119_VLCD_TIMES_0_82                 0x00AE
#define SSD2119_VLCD_TIMES_0_83                 0x00AF
#define SSD2119_VLCD_TIMES_0_84                 0x00B0
#define SSD2119_VLCD_TIMES_0_85                 0x00B1
#define SSD2119_VLCD_TIMES_0_86                 0x00B2
#define SSD2119_VLCD_TIMES_0_87                 0x00B3
#define SSD2119_VLCD_TIMES_0_88                 0x00B4
#define SSD2119_VLCD_TIMES_0_89                 0x00B5
#define SSD2119_VLCD_TIMES_0_90                 0x00B6
#define SSD2119_VLCD_TIMES_0_91                 0x00B7
#define SSD2119_VLCD_TIMES_0_92                 0x00B8
#define SSD2119_VLCD_TIMES_0_93                 0x00B9
#define SSD2119_VLCD_TIMES_0_94                 0x00BA
#define SSD2119_VLCD_TIMES_0_95                 0x00BB
#define SSD2119_VLCD_TIMES_0_96                 0x00BC
#define SSD2119_VLCD_TIMES_0_97                 0x00BD
#define SSD2119_VLCD_TIMES_0_98                 0x00BE
#define SSD2119_VLCD_TIMES_0_99                 0x00BF
#define SSD2119_WRITE_DATA_M                    0x3FFFF
#define SSD2119_WRITE_DATA_S                    0
#define SSD2119_READ_DATA_M                     0x3FFFF
#define SSD2119_READ_DATA_S                     0
#define SSD2119_FRAME_FREQ_SET(ulConfig)        (ulConfig)
#define SSD2119_FRAME_FREQ_50HZ                 0x0000
#define SSD2119_FRAME_FREQ_55HZ                 0x2000
#define SSD2119_FRAME_FREQ_60HZ                 0x5000
#define SSD2119_FRAME_FREQ_65HZ                 0x8000
#define SSD2119_FRAME_FREQ_70HZ                 0xA000
#define SSD2119_FRAME_FREQ_75HZ                 0xC000
#define SSD2119_FRAME_FREQ_80HZ                 0xE000
#define SSD2119_LCD_VERTICAL_MAX                240
#define SSD2119_LCD_HORIZONTAL_MAX              320
#define HORIZ_DIRECTION                         0x30
#define VERT_DIRECTION                          0x38
#define MAPPED_X(x, y)                          (x)
#define MAPPED_Y(x, y)                          (y)

const unsigned char Font8x16[1536] = {   //Vector for font 8x16 pixel
  0x00, 0x00, 0x00, 0x00, 0x00, 0x00, 0x00, 0x00, 0x00, 0x00, 0x00, 0x00, 0x00, 0x00, 0x00, 0x00,
  0x00, 0x00, 0x18, 0x3C, 0x3C, 0x3C, 0x18, 0x18, 0x18, 0x00, 0x18, 0x18, 0x00, 0x00, 0x00, 0x00,
  0x00, 0x66, 0x66, 0x66, 0x24, 0x00, 0x00, 0x00, 0x00, 0x00, 0x00, 0x00, 0x00, 0x00, 0x00, 0x00,
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  0x00, 0x00, 0x00, 0x00, 0x10, 0x38, 0x6C, 0xC6, 0xC6, 0xC6, 0xFE, 0x00, 0x00, 0x00, 0x00, 0x00
};

void SPI_init() {
  //Setup of SPI interface on Arduino board

  //Setup pin direction
  pinMode(SSD2119_DC, OUTPUT);
  pinMode(SSD2119_RST, OUTPUT);
  
  #if HARDWARE_IS_ARDUINO_MEGA==true
    //Setup pin direction
    pinMode(SSD2119_CS, OUTPUT);
    
    //PIN53 of Arduino Mega is a Slave Select.
    pinMode(SS_ATMEL_RESERVED, OUTPUT);    //TEMP TEST
    digitalWrite(SS_ATMEL_RESERVED, HIGH); //TEMP TEST

    //Disable Display's Circuit Select.
    digitalWrite(SSD2119_CS, HIGH);

    //SPI speed and other SPI settings
    SPI.setClockDivider(SPI_CLOCK_DIV2);
   
    //Enable SPI streaming
    SPI.begin();
  #endif
  #if HARDWARE_IS_ARDUINO_DUE==true
    //SPI speed and other SPI settings
    SPI.setClockDivider(10,1);
    //SPI.beginTransaction(SPISettings(14000000, MSBFIRST, SPI_MODE2)); //TEMP TEST
    
    //Enable SPI streaming
    SPI.begin(10);
  #endif

}

void SSD2119_Init() {
  //Hardware SPI initialization
  SPI_init();

  //Display reset
  digitalWrite(SSD2119_RST, LOW);
  delay(1); //[ms]
  digitalWrite(SSD2119_RST, HIGH);
  delay(10); //[ms]

  // Enter sleep mode
  SSD2119WriteCmd(SSD2119_SLEEP_MODE_1_REG);
  SSD2119WriteData(SSD2119_SLEEP_MODE_ENTER);

  // Set initial power parameters
  SSD2119WriteCmd(SSD2119_PWR_CTRL_5_REG);
  SSD2119WriteData(SSD2119_VCOMH_SET(SSD2119_VLCD_TIMES_0_86));
  SSD2119WriteCmd(SSD2119_VCOM_OTP_1_REG);
  SSD2119WriteData(0x0006);

  // Start the oscillator
  SSD2119WriteCmd(SSD2119_OSC_START_REG);
  SSD2119WriteData(0x0001);

  // Set pixel format and basic display orientation (scanning direction)
  SSD2119WriteCmd(SSD2119_OUTPUT_CTRL_REG);
  SSD2119WriteData(SSD2119_OUTPUTCTL_SET(SSD2119_OUTPUT_ORIGIN_DOWNRIGHT));
  SSD2119WriteCmd(SSD2119_LCD_DRIVE_AC_CTRL_REG);
  SSD2119WriteData(0x0600);

  // Exit sleep mode.
  SSD2119WriteCmd(SSD2119_SLEEP_MODE_1_REG);
  SSD2119WriteData(SSD2119_SLEEP_MODE_EXIT);

  // Delay 30mS requested by datasheet
  delay(100); //[ms]

  // Configure pixel color format and MCU interface parameters.
  SSD2119WriteCmd(SSD2119_ENTRY_MODE_REG);
  //SSD2119WriteData(SSD2119_ENTRY_MODE_DEFAULT);  //64kcolors
  SSD2119WriteData(0x48B0);  //264kcolors
  //SSD2119WriteData(0b0110001000110000);  //datasheet
  //SSD2119WriteData(0b0110001000110000);  //datasheet

  // Enable the display.
  SSD2119WriteCmd(SSD2119_DISPLAY_CTRL_REG);
  SSD2119WriteData(0x0033);

  // Set VCIX2 voltage to 6.1V.
  SSD2119WriteCmd(SSD2119_PWR_CTRL_2_REG);
  SSD2119WriteData(SSD2119_OUTPUT_VOLTAGE_SET(SSD2119_OUTPUT_VOLTAGE_6_1V));

  // Configure gamma correction.
  /*
    SSD2119WriteCmd(SSD2119_GAMMA_CTRL_1_REG);
    SSD2119WriteData(0x0000);
    SSD2119WriteCmd(SSD2119_GAMMA_CTRL_2_REG);
    SSD2119WriteData(0x0303);
    SSD2119WriteCmd(SSD2119_GAMMA_CTRL_3_REG);
    SSD2119WriteData(0x0407);
    SSD2119WriteCmd(SSD2119_GAMMA_CTRL_4_REG);
    SSD2119WriteData(0x0301);
    SSD2119WriteCmd(SSD2119_GAMMA_CTRL_5_REG);
    SSD2119WriteData(0x0301);
    SSD2119WriteCmd(SSD2119_GAMMA_CTRL_6_REG);
    SSD2119WriteData(0x0403);
    SSD2119WriteCmd(SSD2119_GAMMA_CTRL_7_REG);
    SSD2119WriteData(0x0707);
    SSD2119WriteCmd(SSD2119_GAMMA_CTRL_8_REG);
    SSD2119WriteData(0x0400);
    SSD2119WriteCmd(SSD2119_GAMMA_CTRL_9_REG);
    SSD2119WriteData(0x0a00);
    SSD2119WriteCmd(SSD2119_GAMMA_CTRL_10_REG);
    SSD2119WriteData(0x1000);
  */
  SSD2119WriteCmd(SSD2119_GAMMA_CTRL_1_REG);
  SSD2119WriteData(0x0000);
  SSD2119WriteCmd(SSD2119_GAMMA_CTRL_2_REG);
  SSD2119WriteData(0x0101);
  SSD2119WriteCmd(SSD2119_GAMMA_CTRL_3_REG);
  SSD2119WriteData(0x0100);
  SSD2119WriteCmd(SSD2119_GAMMA_CTRL_4_REG);
  SSD2119WriteData(0x0305);
  SSD2119WriteCmd(SSD2119_GAMMA_CTRL_5_REG);
  SSD2119WriteData(0x0707);
  SSD2119WriteCmd(SSD2119_GAMMA_CTRL_6_REG);
  SSD2119WriteData(0x0305);
  SSD2119WriteCmd(SSD2119_GAMMA_CTRL_7_REG);
  SSD2119WriteData(0x0707);
  SSD2119WriteCmd(SSD2119_GAMMA_CTRL_8_REG);
  SSD2119WriteData(0x0201);
  SSD2119WriteCmd(SSD2119_GAMMA_CTRL_9_REG);
  SSD2119WriteData(0x1200);
  SSD2119WriteCmd(SSD2119_GAMMA_CTRL_10_REG);
  SSD2119WriteData(0x0900);

  // Configure Vlcd63 and VCOMl.
  SSD2119WriteCmd(SSD2119_PWR_CTRL_3_REG);
  SSD2119WriteData(SSD2119_VLCD63_SET(SSD2119_VREF_TIMES_2_335));
  SSD2119WriteCmd(SSD2119_PWR_CTRL_4_REG);
  SSD2119WriteData(SSD2119_VCOM_SET(SSD2119_VLCD63_TIMES_1_02));

  // Set the display size and ensure that the GRAM window is set to allow
  // access to the full display buffer.
  SSD2119WriteCmd(SSD2119_V_RAM_POS_REG);
  SSD2119WriteData((SSD2119_LCD_VERTICAL_MAX - 1) << 8);
  SSD2119WriteCmd(SSD2119_H_RAM_START_REG);
  SSD2119WriteData(0x0000);
  SSD2119WriteCmd(SSD2119_H_RAM_END_REG);
  SSD2119WriteData(SSD2119_LCD_HORIZONTAL_MAX - 1);
  SSD2119WriteCmd(SSD2119_X_RAM_ADDR_REG);
  SSD2119WriteData(0x00);
  SSD2119WriteCmd(SSD2119_Y_RAM_ADDR_REG);
  SSD2119WriteData(0x00);

  SSD2119WriteCmd(SSD2119_RAM_DATA_REG);
  //delay(2000);  //Used during debug


  //Clear the contents of the display buffer...

  //...using random color
  //for(unsigned long ulCount = 0; ulCount < ((SSD2119_LCD_HORIZONTAL_MAX) * long(SSD2119_LCD_VERTICAL_MAX)); ulCount++)   {
  //  SSD2119WritePixelData(random()*0xffffff);  //Random color!
  //}


  //...using a fix color
  //for (unsigned long ulCount = 0; ulCount < ((SSD2119_LCD_HORIZONTAL_MAX) * long(SSD2119_LCD_VERTICAL_MAX)); ulCount++)   {
  //  SSD2119ClearDisplay(0x000000);  //Black!
  //}

  //...using function
  SSD2119ClearDisplay(0x000000);
}

void SSD2119ClearDisplay(unsigned long ulBackgroundColor){
  for (unsigned long ulCount = 0; ulCount < ((SSD2119_LCD_HORIZONTAL_MAX) * long(SSD2119_LCD_VERTICAL_MAX)); ulCount++)   {
    SSD2119WritePixelData(ulBackgroundColor);
  }
}

void SSD2119DrawOnePixel(unsigned short usX, unsigned short usY, unsigned long ulColor) {
  // Set the X address of the display cursor.
  SSD2119WriteCmd(SSD2119_X_RAM_ADDR_REG);
  SSD2119WriteData(MAPPED_X(usX, usY));

  // Set the Y address of the display cursor.
  SSD2119WriteCmd(SSD2119_Y_RAM_ADDR_REG);
  SSD2119WriteData(MAPPED_Y(usX, usY));

  // Write the pixel value.
  SSD2119WriteCmd(SSD2119_RAM_DATA_REG);
  SSD2119WritePixelData(ulColor);
}

void SSD2119SetCurPos(unsigned long ulStartX, unsigned long ulEndX, unsigned long ulStartY, unsigned long ulEndY) {

  //Write in horizontal direction (FAX)
  SSD2119WriteCmd(SSD2119_ENTRY_MODE_REG);
  SSD2119WriteData(SSD2119_ENTRY_MODE_SET(HORIZ_DIRECTION));

  // Write the X extents of the rectangle
  SSD2119WriteCmd(SSD2119_H_RAM_START_REG);
  SSD2119WriteData(MAPPED_X(ulStartX, ulStartY));  //XStart

  SSD2119WriteCmd(SSD2119_H_RAM_END_REG);
  SSD2119WriteData(MAPPED_X(ulEndX, ulEndY));      //XEnd

  // Write the Y extents of the rectangle
  SSD2119WriteCmd(SSD2119_V_RAM_POS_REG);
  SSD2119WriteData(MAPPED_Y(ulEndX, ulEndY) << 8 | (MAPPED_Y(ulStartX, ulStartY) ));   //Yend_YStart

  // Set the display cursor to the upper left of the rectangle (in application coordinate space).
  SSD2119WriteCmd(SSD2119_X_RAM_ADDR_REG);
  SSD2119WriteData(MAPPED_X(ulStartX, ulStartY));   //Set pos X

  SSD2119WriteCmd(SSD2119_Y_RAM_ADDR_REG);
  SSD2119WriteData(MAPPED_Y(ulStartX, ulStartY));  //Set pos Y

  // Tell the controller we are about to write data into its RAM.
  SSD2119WriteCmd(SSD2119_RAM_DATA_REG);
}

void SSD2119PutChar8x16(unsigned short usX, unsigned short usY, char c, unsigned long fColor, unsigned long bColor) {
  unsigned int i, j;

  SSD2119SetCurPos(usX, usX + 8 - 1, usY, usY + 16 - 1);
  for (i = 0; i < 16; i++)
  {
    unsigned char m = Font8x16[(c - 0x20) * 16 + i];
    for (j = 0; j < 8; j++)
    {
      if ((m & 0x80) == 0x80)
      {
        //This pixel is 'Foreground color'
        SSD2119WritePixelData(fColor);
      }
      else
      {
        //This pixel is 'background color'
        SSD2119WritePixelData(bColor);
      }
      m <<= 1;
    }
  }
}

void SSD2119DisplayString(unsigned short usX, unsigned short usY, const char* pcString, unsigned long fColor, unsigned long bColor) {
  //This sub have some lines under test. FIX IT!
  unsigned char uc_count = 0;

  while (*pcString)
  {
    if ( *pcString < 0x80)
    {
      SSD2119PutChar8x16(usX + uc_count * 8, usY, *pcString, fColor, bColor);
      pcString++;   //Point to next char
      uc_count++;   //Unsigned Char counter ++
    }
    else
    {
      //SSD2119PutGB1616(usX + ucl * 8, usY, (unsigned char*)pcString, fColor, bColor);
      pcString += 2;
      uc_count += 2;
    }
  }
}

void SSD2119WriteCmd(unsigned char ucCmd) {
  SSD2119Write(SSD2119_DC_COMMAND, ucCmd, SSD2119_NORMAL_REG);
}

void SSD2119WriteData(unsigned long ulData) {
  SSD2119Write(SSD2119_DC_DATA, ulData, SSD2119_NORMAL_REG);
}

void SSD2119WritePixelData(unsigned long ulData) {
  SSD2119Write(SSD2119_DC_DATA, ulData, SSD2119_GRAM_REG);
  //SSD2119Write(SSD2119_DC_DATA, ulData, SSD2119_NORMAL_REG);
}

void  SSD2119Write(unsigned char ucDC, unsigned long ulInstruction, unsigned char ucRegType) {
  #if HARDWARE_IS_ARDUINO_MEGA==true
  digitalWrite(SSD2119_CS, LOW);   //Too slow. FIX IT!
  digitalWrite(SSD2119_DC, ucDC);  //Too slow. FIX IT!
  if (ucDC == SSD2119_DC_DATA)
  {
    //Send DATA
    if (ucRegType == SSD2119_NORMAL_REG)
    {
      //Send DATA for NORMAL_REGISTER
      SPI.transfer((ulInstruction >> 8) & 0xFF);
      SPI.transfer(ulInstruction & 0xFF);
    }
    else
    {
      //Send DATA for GRAPHICS_REGISTER
      //6 bits per color
      //SPI.transfer( (ulInstruction >> 12) & 0xFC);
      //SPI.transfer( (ulInstruction >> 6) & 0xFC);
      //SPI.transfer( (ulInstruction & 0xFC);
      //8 bits per color
      SPI.transfer((ulInstruction >> 16) & 0xFF);  //Red
      SPI.transfer((ulInstruction >> 8) & 0xFF);   //Green
      SPI.transfer(ulInstruction & 0xFF);          //Blue
    }
  }
  else
  {
    //Send INSTRUCTION
    SPI.transfer(ulInstruction & 0xFF);
  }
  digitalWrite(SSD2119_CS, HIGH);  //Too slow. FIX IT!
  #endif
  
  #if HARDWARE_IS_ARDUINO_DUE==true
  digitalWrite(SSD2119_DC, ucDC);  //Too slow. FIX IT!
  if (ucDC == SSD2119_DC_DATA)
  {
    //Send DATA
    if (ucRegType == SSD2119_NORMAL_REG)
    {
      //Send DATA for NORMAL_REGISTER
      SPI.transfer(10,(ulInstruction >> 8) & 0xFF);
      SPI.transfer(10,ulInstruction & 0xFF);
    }
    else
    {
      //Send DATA for GRAPHICS_REGISTER
      //6 bits per color
      //SPI.transfer( (ulInstruction >> 12) & 0xFC);
      //SPI.transfer( (ulInstruction >> 6) & 0xFC);
      //SPI.transfer( (ulInstruction & 0xFC);
      //8 bits per color
      SPI.transfer(10,(ulInstruction >> 16) & 0xFF);  //Red
      SPI.transfer(10,(ulInstruction >> 8) & 0xFF);   //Green
      SPI.transfer(10,ulInstruction & 0xFF);          //Blue
    }
  }
  else
  {
    //Send INSTRUCTION
    SPI.transfer(10,ulInstruction & 0xFF);
  }
  #endif
}

/*  UNDER TEST  */ /*  NEVER TESTED  */
/*  UNDER TEST  */ /*  NEVER TESTED  */

void SSD2119EnterSleepMode(void) {
  // Sleep set
  SSD2119WriteCmd(SSD2119_SLEEP_MODE_1_REG);
  SSD2119WriteData(0x0001);

  // Display Control
  SSD2119WriteCmd(SSD2119_DISPLAY_CTRL_REG);
  SSD2119WriteData(0x0000);
}

void SSD2119ExitSleepMode(void) {
  SSD2119WriteCmd(SSD2119_SLEEP_MODE_1_REG);
  SSD2119WriteData(0x0000);
  SSD2119WriteCmd(SSD2119_DISPLAY_CTRL_REG);
  SSD2119WriteData(0x0033);
}

/*void SSD2119DisplayClear(unsigned long ulColor) {
  SSD2119DrawRectangleFill(0, 0, SSD2119_LCD_HORIZONTAL_MAX - 1, SSD2119_LCD_VERTICAL_MAX - 1 , ulColor);
}*/

void SSD2119DrawHorizontalLine(unsigned short usStartX, unsigned short usEndX, unsigned short usY, unsigned long ulColor) {
  SSD2119SetCurPos(usStartX, usEndX, usY, usY);
  for (unsigned short usTemp = (usEndX - usStartX); usTemp > 0  ; usTemp--) {
    SSD2119WritePixelData(ulColor);  
  }

  /*
  while (usStartX <= usEndX)
  {
    SSD2119DrawOnePixel(usStartX, usY, ulColor);
    usStartX++;
  }*/
}

void SSD2119DrawVerticalLine(unsigned short usX, unsigned short usStartY, unsigned short usEndY, unsigned long ulColor) {
  while (usStartY <= usEndY)
  {
    SSD2119DrawOnePixel(usX, usStartY, ulColor);
    usStartY++;
  }
}

void SSD2119DrawRectangle(unsigned short usX1, unsigned short usY1, unsigned short usX2, unsigned short usY2, unsigned long ulColor) {
  SSD2119DrawVerticalLine(usX1,usY1,usY2,ulColor);
  SSD2119DrawVerticalLine(usX2,usY1,usY2,ulColor);
  SSD2119DrawHorizontalLine(usX1,usX2,usY1,ulColor);
  SSD2119DrawHorizontalLine(usX1,usX2,usY2,ulColor);
}

void SSD2119DrawRectangleFill(unsigned short usStartX, unsigned short usStartY, unsigned short usEndX, unsigned short usEndY, unsigned long ulColor) {

  while (usStartY <= usEndY) {
    SSD2119DrawHorizontalLine(usStartX, usEndX, usStartY, ulColor);
    usStartY++;
  }
  
  //SSD2119SetCurPos(usStartX, usEndX, usStartY, usEndY);

  //for (unsigned short usTemp = 0; usTemp <= ((long(usEndX) - usStartX + 1) * (long(usEndY) - usStartY + 1)); usTemp++)
  //{
  //  SSD2119WriteData(ulColor);
  //}
}


/*
 * ______________________________________________________________________________________________________________________________
 * ______________________________________________________________________________________________________________________________
 * ______________________________________________________________________________________________________________________________
 *  BIG FONT
 * ______________________________________________________________________________________________________________________________
 * ______________________________________________________________________________________________________________________________
 * ______________________________________________________________________________________________________________________________
*/

static const uint8_t fontb[] PROGMEM = {
  0x9A, 0xAC, // size
  0x0A, // width
  0x1F, // height
  0x20, // first char
  0x60, // char count

  // char widths
  0x00, 0x05, 0x09, 0x11, 0x0E, 0x17, 0x13, 0x03, 0x07, 0x07,
  0x0D, 0x0F, 0x04, 0x08, 0x04, 0x0C, 0x0E, 0x09, 0x0E, 0x0E,
  0x10, 0x0E, 0x0E, 0x0E, 0x0E, 0x0E, 0x04, 0x04, 0x0F, 0x0F,
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  0x0D, 0x09, 0x03, 0x09, 0x0F, 0x0C,

  // font data
  0x00, 0xF8, 0xF8, 0xF8, 0x00, 0x00, 0xFF, 0xFF, 0xFF, 0x00, 0xC0, 0xE1, 0xE3, 0xE1, 0xC0, 0x00, 0x02, 0x02, 0x02, 0x00, // 33
  0x7F, 0xFF, 0x7F, 0x00, 0x00, 0x00, 0x7F, 0xFF, 0x7F, 0x00, 0x00, 0x00,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 0x00, // 34
  0x00, 0x00, 0x00, 0x00, 0x00, 0xC0, 0xF8, 0xF8, 0x38, 0x00, 0x00, 0xC0,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 0x00, // 35
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  0xFE, 0xFE, 0x06, 0x06, 0x06, 0x06, 0x06, 0x06, 0x06, 0x06, 0xFE, 0xFE,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 0x02, 0x02 // 127

};






void Bdrawstring (unsigned short usX, unsigned short usY, const char* pcString, unsigned long fColor, unsigned long bColor)
{
  int x;

  x = usX;
  while (*pcString)
  {
    if ( *pcString < 0x80)
    {
      x += BdrawChar(x , usY, *pcString, fColor, bColor);
      pcString++;
    }
    else
    {
      //SSD2119PutGB1616(usX + ucl * 8, usY, (unsigned char*)pcString, fColor, bColor);
      pcString += 2;
    }
  }
}


int BdrawChar(int x, int y, char ch, unsigned long fColor, unsigned long bColor)
{
  //https://rweather.github.io/arduinolibs/Bitmap_8cpp_source.html
  uint8_t height = pgm_read_byte_near(fontb + 3);
  if (ch == ' ') {
    //Routine per fare lo spazio
    int spaceWidth = 10;  //Temporanea larghezza dello spazio
    for (uint8_t cx = x; cx < x+spaceWidth; ++cx) {
      for (uint8_t cy = y; cy < y+height; ++cy) {
        SSD2119DrawOnePixel( cx, cy ,  bColor); 
      }
    }
    return spaceWidth;
  }
  uint8_t first = pgm_read_byte_near(fontb + 4);
  uint8_t count = pgm_read_byte_near(fontb + 5);
  uint8_t index = (uint8_t)ch;
  if (index < first || index >= (first + count))
    return 0;
  index -= first;
  uint8_t heightBytes = (height + 7) >> 3;;
  uint8_t width;
  const uint8_t *image;

  // Variable-width font.
  width = pgm_read_byte_near(fontb + 6 + index);
  image = ((const uint8_t *)fontb) + 6 + count;
  for (uint8_t temp = 0; temp < index; ++temp) {
    // Scan through all previous characters to find the starting
    // location for this one.
    image += pgm_read_byte_near(fontb + 6 + temp) * heightBytes;
  }
  //INIZIO PRE
  #define PRE 1
    for (uint8_t cx = 0; cx < PRE; ++cx) {
      for (uint8_t cy = 0; cy < heightBytes; ++cy) {
          uint8_t value = 0x00;
          int posn;
          if (heightBytes > 1 && cy == (heightBytes - 1))
             posn = height - 8;
         else
             posn = cy * 8;
          for (uint8_t bit = 0; bit < 8; ++bit) {
              if ((posn + bit) >= (cy * 8) && (posn + bit) <= height) {
                  if (value & 0x01)
                      SSD2119DrawOnePixel(x + cx, y + posn + bit,  fColor);
                  else
                      SSD2119DrawOnePixel(x + cx, y + posn + bit,  bColor);
              }
              value >>= 1;
          }
      }
    }
    x=x+PRE;
  //FINE PRE
  for (uint8_t cx = 0; cx < width; ++cx) {
    for (uint8_t cy = 0; cy < heightBytes; ++cy) {
      uint8_t value = pgm_read_byte_near(image + cy * width + cx);
      int posn;
      if (heightBytes > 1 && cy == (heightBytes - 1))
        posn = height - 8;
      else
        posn = cy * 8;
      for (uint8_t bit = 0; bit < 8; ++bit) {
        if ((posn + bit) >= (cy * 8) && (posn + bit) <= height) {
          if (value & 0x01)
            SSD2119DrawOnePixel(x + cx, y + posn + bit, fColor);
          else
            SSD2119DrawOnePixel(x + cx, y + posn + bit, bColor);
        }
        value >>= 1;
      }
    }
  }

  //INIZIO POST
  x=x+width;
  #define POST 1
    for (uint8_t cx = 0; cx < POST; ++cx) {
       for (uint8_t cy = 0; cy < heightBytes; ++cy) {
           uint8_t value = 0x00;
           int posn;
           if (heightBytes > 1 && cy == (heightBytes - 1))
              posn = height - 8;
          else
              posn = cy * 8;
           for (uint8_t bit = 0; bit < 8; ++bit) {
               if ((posn + bit) >= (cy * 8) && (posn + bit) <= height) {
                   if (value & 0x01)
                       SSD2119DrawOnePixel(x + cx, y + posn + bit,  fColor);
                   else
                       SSD2119DrawOnePixel(x + cx, y + posn + bit,  bColor);
               }
               value >>= 1;
           }
       }
    }
  //FINE POST
  return width + PRE + POST;
}



